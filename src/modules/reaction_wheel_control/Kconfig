## src/modules/reaction_wheel_control/Kconfig
```kconfig
menuconfig MODULES_REACTION_WHEEL_CONTROL
	bool "reaction_wheel_control"
	default n
	---help---
		Enable support for reaction_wheel_control
```

## src/modules/reaction_wheel_torque_control/Kconfig
```kconfig
menuconfig MODULES_REACTION_WHEEL_TORQUE_CONTROL
	bool "reaction_wheel_torque_control"
	default n
	---help---
		Enable support for reaction_wheel_torque_control
```
